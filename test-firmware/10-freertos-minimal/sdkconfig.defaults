## test-firmware/10-freertos-minimal/sdkconfig.defaults
```kconfig
# ESP32 target
CONFIG_IDF_TARGET="esp32"

# Compiler optimizations
CONFIG_COMPILER_OPTIMIZATION_SIZE=y

# FreeRTOS
CONFIG_FREERTOS_HZ=1000

# Logging (verbose for debugging)
CONFIG_LOG_DEFAULT_LEVEL_INFO=y
CONFIG_LOG_MAXIMUM_LEVEL_VERBOSE=y
```

## test-firmware/20-benchmark/sdkconfig.defaults
```kconfig
# Minimal config for benchmark firmware
CONFIG_IDF_TARGET="esp32"
CONFIG_ESP_DEFAULT_CPU_FREQ_MHZ_240=y
CONFIG_FREERTOS_HZ=1000
# Reduce binary size
CONFIG_COMPILER_OPTIMIZATION_SIZE=y
CONFIG_LOG_DEFAULT_LEVEL_INFO=y
CONFIG_BOOTLOADER_LOG_LEVEL_WARN=y
# Disable unnecessary features
CONFIG_ESP_WIFI_ENABLED=n
CONFIG_BT_ENABLED=n
```

## test-firmware/50-lvgl-basic/sdkconfig.defaults
```kconfig
# ESP32 target
CONFIG_IDF_TARGET="esp32"

# Compiler optimizations
CONFIG_COMPILER_OPTIMIZATION_SIZE=y

# Enable LVGL
CONFIG_LV_COLOR_DEPTH_16=y
CONFIG_LV_COLOR_16_SWAP=n

# FreeRTOS
CONFIG_FREERTOS_HZ=1000

# Logging
CONFIG_LOG_DEFAULT_LEVEL_INFO=y
CONFIG_LOG_MAXIMUM_LEVEL_VERBOSE=y
```
